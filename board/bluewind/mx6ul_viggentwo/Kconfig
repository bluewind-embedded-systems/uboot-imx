## board/bluewind/mx6ul_viggentwo/Kconfig
```kconfig
if TARGET_MX6UL_VIGGENTWO

config SYS_BOARD
	default "mx6ul_viggentwo"

config SYS_VENDOR
	default "bluewind"

config SYS_SOC
	default "mx6"

config SYS_CONFIG_NAME
	default "mx6ul_viggentwo"

endif
```

## configs/mx6ul_viggentwo_defconfig
```kconfig
CONFIG_ARM=y
CONFIG_ARCH_MX6=y
CONFIG_TARGET_MX6UL_VIGGENTWO=y
CONFIG_SYS_EXTRA_OPTIONS="IMX_CONFIG=board/bluewind/mx6ul_viggentwo/imximage.cfg"
CONFIG_CMD_GPIO=y
CONFIG_CMD_DHCP=y
CONFIG_CMD_PING=y
```
